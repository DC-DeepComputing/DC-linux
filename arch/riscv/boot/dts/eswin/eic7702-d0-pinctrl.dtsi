// SPDX-License-Identifier: (GPL-2.0 OR MIT)
/*
 * Copyright (c) 2026 Beijing ESWIN Computing Technology Co., Ltd.
 *
 * ESWIN's EIC7702 SoC pin-mux and pin-config options are listed as
 * device tree nodes in this file.
 *
 * Authors: Yulin Lu <luyulin@eswincomputing.com>
 */

&d0_pinctrl{
	//func1
	d0_sata_act_led_pins: sata-act-led-pins{
		pins = "gpio27";
		function = "sata";
	};

	d0_emmc_led_ctrl_pins: emmc-led-ctrl-pins {
		pins = "gpio29";
		function = "emmc";
	};

	d0_sd0_led_ctrl_pins: sd0-led-ctrl-pins {
		pins = "gpio34";
		function = "sdio";
	};

	d0_sd1_led_ctrl_pins: sd1-led-ctrl-pins {
		pins = "spi1_d2";
		function = "sdio";
	};

	d0_i2c6_pins: i2c6-pins {
		pins = "uart1_cts", "uart1_rts";
		function = "i2c";
	};

	d0_i2c7_pins: i2c7-pins {
		pins = "uart2_tx", "uart2_rx";
		function = "i2c";
	};

	d0_i2c9_pins: i2c9-pins {
		pins = "spi1_d0", "spi1_d1";
		function = "i2c";
	};

	d0_pwm1_pins: pwm1-pins {
		pins = "spi1_d3";
		function = "pwm";
	};

	d0_pwm2_pins: pwm2-pins {
		pins = "spi1_cs1_n";
		function = "pwm";
	};

	d0_mipi_csi_xtrig0_pins: mipi-csi-xtrig0-pins {
		pins = "gpio92";
		function = "mipi_csi";
	};

	d0_mipi_csi_xtrig1_pins: mipi-csi-xtrig1-pins {
		pins = "gpio93";
		function = "mipi_csi";
	};

	d0_dual_spi2_pins: dual-spi2-pins {
		pins = "spi2_cs0_n", "jtag0_tck", "jtag0_tms", "jtag0_tdi";
		function = "spi";
	};

	d0_quad_spi2_pins: quad-spi2-pins {
		pins = "spi2_cs0_n", "spi2_cs1_n", "jtag0_tck", "jtag0_tms", "jtag0_tdi", "jtag0_tdo", "gpio5";
		function = "spi";
	};

	//func2
	d0_gpio1_pins: gpio1-pins {
		pins = "jtag0_tck";
		function = "gpio";
	};

	d0_gpio2_pins: gpio2-pins {
		pins = "jtag0_tms";
		function = "gpio";
	};

	d0_gpio3_pins: gpio3-pins {
		pins = "jtag0_tdi";
		function = "gpio";
	};

	d0_gpio4_pins: gpio4-pins {
		pins = "jtag0_tdo";
		function = "gpio";
	};

	d0_gpio6_pins: gpio6-pins {
		pins = "spi2_cs0_n";
		function = "gpio";
	};

	d0_gpio12_pins: gpio12-pins {
		pins = "spi2_cs1_n";
		function = "gpio";
	};

	d0_gpio13_pins: gpio13-pins {
		pins = "mode_set0";
		function = "gpio";
	};

	d0_gpio14_pins: gpio14-pins {
		pins = "mode_set1";
		function = "gpio";
	};

	d0_gpio15_pins: gpio15-pins {
		pins = "mode_set2";
		function = "gpio";
	};

	d0_gpio16_pins: gpio16-pins {
		pins = "mode_set3";
		function = "gpio";
	};

	d0_gpio18_pins: gpio18-pins {
		pins = "i2s0_bclk";
		function = "gpio";
	};

	d0_gpio19_pins: gpio19-pins {
		pins = "i2s0_wclk";
		function = "gpio";
	};

	d0_gpio20_pins: gpio20-pins {
		pins = "i2s0_sdi";
		function = "gpio";
	};

	d0_gpio21_pins: gpio21-pins {
		pins = "i2s0_sdo";
		function = "gpio";
	};

	d0_gpio22_pins: gpio22-pins {
		pins = "i2s_mclk";
		function = "gpio";
	};

	d0_gpio23_pins: gpio23-pins {
		pins = "i2s2_bclk";
		function = "gpio";
	};

	d0_gpio24_pins: gpio24-pins {
		pins = "i2s2_wclk";
		function = "gpio";
	};

	d0_gpio25_pins: gpio25-pins {
		pins = "i2s2_sdi";
		function = "gpio";
	};

	d0_gpio26_pins: gpio26-pins {
		pins = "i2s2_sdo";
		function = "gpio";
	};

	d0_gpio29_pins: gpio29-pins {
		pins = "gpio29";
		function = "gpio";
	};

	d0_gpio30_pins: gpio30-pins {
		pins = "i2s1_bclk";
		function = "gpio";
	};

	d0_gpio31_pins: gpio31-pins {
		pins = "i2s1_wclk";
		function = "gpio";
	};

	d0_gpio32_pins: gpio32-pins {
		pins = "i2s1_sdi";
		function = "gpio";
	};

	d0_gpio33_pins: gpio33-pins {
		pins = "i2s1_sdo";
		function = "gpio";
	};

	d0_gpio34_pins: gpio34-pins {
		pins = "gpio34";
		function = "gpio";
	};

	d0_gpio35_pins: gpio35-pins {
		pins = "spi1_cs0_n";
		function = "gpio";
	};

	d0_gpio36_pins: gpio36-pins {
		pins = "spi1_clk";
		function = "gpio";
	};

	d0_gpio37_pins: gpio37-pins {
		pins = "spi1_d0";
		function = "gpio";
	};

	d0_gpio38_pins: gpio38-pins {
		pins = "spi1_d1";
		function = "gpio";
	};

	d0_gpio39_pins: gpio39-pins {
		pins = "spi1_d2";
		function = "gpio";
	};

	d0_gpio40_pins: gpio40-pins {
		pins = "spi1_d3";
		function = "gpio";
	};

	d0_gpio41_pins: gpio41-pins {
		pins = "spi1_cs1_n";
		function = "gpio";
	};

	d0_gpio42_pins: gpio42-pins {
		pins = "usb0_pwren";
		function = "gpio";
	};

	d0_gpio43_pins: gpio43-pins {
		pins = "usb1_pwren";
		function = "gpio";
	};

	d0_gpio44_pins: gpio44-pins {
		pins = "i2c0_scl";
		function = "gpio";
	};

	d0_gpio45_pins: gpio45-pins {
		pins = "i2c0_sda";
		function = "gpio";
	};

	d0_gpio46_pins: gpio46-pins {
		pins = "i2c1_scl";
		function = "gpio";
	};

	d0_gpio47_pins: gpio47-pins {
		pins = "i2c1_sda";
		function = "gpio";
	};

	d0_gpio48_pins: gpio48-pins {
		pins = "i2c2_scl";
		function = "gpio";
	};

	d0_gpio49_pins: gpio49-pins {
		pins = "i2c2_sda";
		function = "gpio";
	};

	d0_gpio50_pins: gpio50-pins {
		pins = "i2c3_scl";
		function = "gpio";
	};

	d0_gpio51_pins: gpio51-pins {
		pins = "i2c3_sda";
		function = "gpio";
	};

	d0_gpio52_pins: gpio52-pins {
		pins = "i2c4_scl";
		function = "gpio";
	};

	d0_gpio53_pins: gpio53-pins {
		pins = "i2c4_sda";
		function = "gpio";
	};

	d0_gpio54_pins: gpio54-pins {
		pins = "i2c5_scl";
		function = "gpio";
	};

	d0_gpio55_pins: gpio55-pins {
		pins = "i2c5_sda";
		function = "gpio";
	};

	d0_gpio56_pins: gpio56-pins {
		pins = "uart0_tx";
		function = "gpio";
	};

	d0_gpio57_pins: gpio57-pins {
		pins = "uart0_rx";
		function = "gpio";
	};

	d0_gpio58_pins: gpio58-pins {
		pins = "uart1_tx";
		function = "gpio";
	};

	d0_gpio59_pins: gpio59-pins {
		pins = "uart1_rx";
		function = "gpio";
	};

	d0_gpio60_pins: gpio60-pins {
		pins = "uart1_cts";
		function = "gpio";
	};

	d0_gpio61_pins: gpio61-pins {
		pins = "uart1_rts";
		function = "gpio";
	};

	d0_gpio62_pins: gpio62-pins {
		pins = "uart2_tx";
		function = "gpio";
	};

	d0_gpio63_pins: gpio63-pins {
		pins = "uart2_rx";
		function = "gpio";
	};

	d0_gpio68_pins: gpio68-pins {
		pins = "fan_pwm";
		function = "gpio";
	};

	d0_gpio69_pins: gpio69-pins {
		pins = "fan_tach";
		function = "gpio";
	};

	d0_gpio70_pins: gpio70-pins {
		pins = "mipi_csi0_xvs";
		function = "gpio";
	};

	d0_gpio71_pins: gpio71-pins {
		pins = "mipi_csi0_xhs";
		function = "gpio";
	};

	d0_gpio72_pins: gpio72-pins {
		pins = "mipi_csi0_mclk";
		function = "gpio";
	};

	d0_gpio73_pins: gpio73-pins {
		pins = "mipi_csi1_xvs";
		function = "gpio";
	};

	d0_gpio74_pins: gpio74-pins {
		pins = "mipi_csi1_xhs";
		function = "gpio";
	};

	d0_gpio75_pins: gpio75-pins {
		pins = "mipi_csi1_mclk";
		function = "gpio";
	};

	d0_gpio76_pins: gpio76-pins {
		pins = "mipi_csi2_xvs";
		function = "gpio";
	};

	d0_gpio77_pins: gpio77-pins {
		pins = "mipi_csi2_xhs";
		function = "gpio";
	};

	d0_gpio78_pins: gpio78-pins {
		pins = "mipi_csi2_mclk";
		function = "gpio";
	};

	d0_gpio79_pins: gpio79-pins {
		pins = "mipi_csi3_xvs";
		function = "gpio";
	};

	d0_gpio80_pins: gpio80-pins {
		pins = "mipi_csi3_xhs";
		function = "gpio";
	};

	d0_gpio81_pins: gpio81-pins {
		pins = "mipi_csi3_mclk";
		function = "gpio";
	};

	d0_gpio88_pins: gpio88-pins {
		pins = "spi3_cs_n";
		function = "gpio";
	};

	d0_gpio89_pins: gpio89-pins {
		pins = "spi3_clk";
		function = "gpio";
	};

	d0_gpio90_pins: gpio90-pins {
		pins = "spi3_di";
		function = "gpio";
	};

	d0_gpio91_pins: gpio91-pins {
		pins = "spi3_do";
		function = "gpio";
	};

	d0_gpio92_pins: gpio92-pins {
		pins = "gpio92";
		function = "gpio";
	};

	d0_gpio93_pins: gpio93-pins {
		pins = "gpio93";
		function = "gpio";
	};

	d0_gpio94_pins: gpio94-pins {
		pins = "s_mode";
		function = "gpio";
	};

	d0_gpio95_pins: gpio95-pins {
		pins = "gpio95";
		function = "gpio";
	};

	d0_gpio96_pins: gpio96-pins {
		pins = "spi0_cs_n";
		function = "gpio";
	};

	d0_gpio97_pins: gpio97-pins {
		pins = "spi0_clk";
		function = "gpio";
	};

	d0_gpio98_pins: gpio98-pins {
		pins = "spi0_d0";
		function = "gpio";
	};

	d0_gpio99_pins: gpio99-pins {
		pins = "spi0_d1";
		function = "gpio";
	};

	d0_gpio100_pins: gpio100-pins {
		pins = "spi0_d2";
		function = "gpio";
	};

	d0_gpio101_pins: gpio101-pins {
		pins = "spi0_d3";
		function = "gpio";
	};

	d0_gpio102_pins: gpio102-pins {
		pins = "i2c10_scl";
		function = "gpio";
	};

	d0_gpio103_pins: gpio103-pins {
		pins = "i2c10_sda";
		function = "gpio";
	};

	d0_gpio104_pins: gpio104-pins {
		pins = "i2c11_scl";
		function = "gpio";
	};

	d0_gpio105_pins: gpio105-pins {
		pins = "i2c11_sda";
		function = "gpio";
	};

	d0_gpio107_pins: gpio107-pins {
		pins = "boot_sel0";
		function = "gpio";
	};

	d0_gpio108_pins: gpio108-pins {
		pins = "boot_sel1";
		function = "gpio";
	};

	d0_gpio109_pins: gpio109-pins {
		pins = "boot_sel2";
		function = "gpio";
	};

	d0_gpio110_pins: gpio110-pins {
		pins = "boot_sel3";
		function = "gpio";
	};

	d0_gpio7_pins: gpio7-pins {
		pins = "jtag1_tck";
		function = "gpio";
	};

	d0_gpio8_pins: gpio8-pins {
		pins = "jtag1_tms";
		function = "gpio";
	};

	d0_gpio9_pins: gpio9-pins {
		pins = "jtag1_tdi";
		function = "gpio";
	};

	d0_gpio17_pins: gpio17-pins {
		pins = "jtag2_trst";
		function = "gpio";
	};

	d0_gpio64_pins: gpio64-pins {
		pins = "jtag2_tck";
		function = "gpio";
	};

	d0_gpio65_pins: gpio65-pins {
		pins = "jtag2_tms";
		function = "gpio";
	};

	d0_gpio66_pins: gpio66-pins {
		pins = "jtag2_tdi";
		function = "gpio";
	};

	//func3
	d0_uart3_pins: uart3-pins {
		pins = "gpio92", "gpio93";
		function = "uart";
	};

	d0_uart4_pins: uart4-pins {
		pins = "spi1_d0", "spi1_d1";
		function = "uart";
	};

	//func0
	d0_gpio0_pins: gpio0-pins {
		pins = "gpio0";
		function = "gpio";
	};

	d0_gpio5_pins: gpio5-pins {
		pins = "gpio5";
		function = "gpio";
	};

	d0_gpio11_pins: gpio11-pins {
		pins = "gpio11";
		function = "gpio";
	};

	d0_gpio27_pins: gpio27-pins {
		pins = "gpio27";
		function = "gpio";
	};

	d0_gpio28_pins: gpio28-pins {
		pins = "gpio28";
		function = "gpio";
	};

	d0_gpio106_pins: gpio106-pins {
		pins = "gpio106";
		function = "gpio";
	};

	d0_gpio111_pins: gpio111-pins {
		pins = "gpio111";
		function = "gpio";
	};

	d0_chip_mode_pins: chip-mode-pins {
		pins = "chip_mode";
		function = "chip_mode";
	};

	d0_sdio0_pins: sdio0-pins {
		pins = "mode_set0", "mode_set1";
		function = "sdio";
	};

	d0_sdio1_pins: sdio1-pins {
		pins = "mode_set2", "mode_set3";
		function = "sdio";
	};

	d0_jtag0_pins: jtag0-pins {
		pins = "jtag0_tck", "jtag0_tms", "jtag0_tdi", "jtag0_tdo";
		function = "jtag";
	};

	d0_pcie_pins: pcie-pins {
		pins = "pcie_clkreq_n", "pcie_wake_n", "pcie_perst_n";
		function = "pcie";
	};

	d0_hdmi_pins: hdmi-pins {
		pins = "hdmi_scl", "hdmi_sda", "hdmi_cec";
		function = "hdmi";
	};

	d0_rgmii0_pins: rgmii0-pins {
		pins = "rgmii0_clk_125", "rgmii0_txen", "rgmii0_txclk", "rgmii0_txd0",
				"rgmii0_txd1", "rgmii0_txd2", "rgmii0_txd3", "rgmii0_rxclk",
				"rgmii0_rxdv", "rgmii0_rxd0", "rgmii0_rxd1", "rgmii0_rxd2",
				"rgmii0_rxd3", "rgmii0_mdc", "rgmii0_mdio", "rgmii0_intb";
		function = "hdmi";
	};

	d0_rgmii1_pins: rgmii1-pins {
		pins = "rgmii1_clk_125", "rgmii1_txen", "rgmii1_txclk", "rgmii1_txd0",
				"rgmii1_txd1", "rgmii1_txd2", "rgmii1_txd3", "rgmii1_rxclk",
				"rgmii1_rxdv", "rgmii1_rxd0", "rgmii1_rxd1", "rgmii1_rxd2",
				"rgmii1_rxd3", "rgmii1_mdc", "rgmii1_mdio", "rgmii1_intb";
		function = "hdmi";
	};

	d0_i2s0_pins: i2s0-pins {
		pins = "i2s0_bclk", "i2s0_wclk", "i2s0_sdi", "i2s0_sdo", "i2s_mclk";
		function = "hdmi";
	};

	d0_i2s1_pins: i2s1-pins {
		pins = "i2s1_bclk", "i2s1_wclk", "i2s1_sdi", "i2s1_sdo", "i2s_mclk";
		function = "hdmi";
	};

	d0_i2s2_pins: i2s2-pins {
		pins = "i2s2_bclk", "i2s2_wclk", "i2s2_sdi", "i2s2_sdo", "i2s_mclk";
		function = "hdmi";
	};

	d0_usb0_pwren_pins: usb0-pwren-pins {
		pins = "usb0_pwren";
		function = "usb";
	};

	d0_usb1_pwren_pins: usb1-pwren-pins {
		pins = "usb1_pwren";
		function = "usb";
	};

	d0_i2c0_pins: i2c0-pins {
		pins = "i2c0_scl", "i2c0_sda";
		function = "i2c";
	};

	d0_i2c1_pins: i2c1-pins {
		pins = "i2c1_scl", "i2c1_sda";
		function = "i2c";
	};

	d0_i2c2_pins: i2c2-pins {
		pins = "i2c2_scl", "i2c2_sda";
		function = "i2c";
	};

	d0_i2c3_pins: i2c3-pins {
		pins = "i2c3_scl", "i2c3_sda";
		function = "i2c";
	};

	d0_i2c4_pins: i2c4-pins {
		pins = "i2c4_scl", "i2c4_sda";
		function = "i2c";
	};

	d0_i2c5_pins: i2c5-pins {
		pins = "i2c5_scl", "i2c5_sda";
		function = "i2c";
	};

	d0_i2c8_pins: i2c8-pins {
		pins = "gpio92", "gpio93";
		function = "i2c";
	};

	d0_i2c10_pins: i2c10-pins {
		pins = "i2c10_scl", "i2c10_sda";
		function = "i2c";
	};

	d0_i2c11_pins: i2c11-pins {
		pins = "i2c11_scl", "i2c11_sda";
		function = "i2c";
	};

	d0_uart0_pins: uart0-pins {
		pins = "uart0_tx", "uart0_rx";
		function = "uart";
	};

	d0_uart1_pins: uart1-pins {
		pins = "uart1_tx", "uart1_rx", "uart1_cts", "uart1_rts";
		function = "uart";
	};

	d0_uart2_pins: uart2-pins {
		pins = "uart2_tx", "uart2_rx";
		function = "uart";
	};

	d0_fan_pwm_pins: fan-pwm-pins {
		pins = "fan_pwm";
		function = "pwm";
	};

	d0_fan_tach_pins: fan-tach-pins {
		pins = "fan_tach";
		function = "fan_tach";
	};

	d0_mipi_csi0_pins: mipi-csi0-pins {
		pins = "mipi_csi0_xvs", "mipi_csi0_xhs", "mipi_csi0_mclk";
		function = "mipi";
	};

	d0_mipi_csi1_pins: mipi-csi1-pins {
		pins = "mipi_csi1_xvs", "mipi_csi1_xhs", "mipi_csi1_mclk";
		function = "mipi";
	};

	d0_mipi_csi2_pins: mipi-csi2-pins {
		pins = "mipi_csi2_xvs", "mipi_csi2_xhs", "mipi_csi2_mclk";
		function = "mipi";
	};

	d0_mipi_csi3_pins: mipi-csi3-pins {
		pins = "mipi_csi3_xvs", "mipi_csi3_xhs", "mipi_csi3_mclk";
		function = "mipi";
	};

	d0_s_mode_pins: s-mode-pins {
		pins = "s_mode";
		function = "s_mode";
	};

	d0_boot_sel0_pins: boot-sel0-pins {
		pins = "boot_sel0";
		function = "boot_sel";
	};

	d0_boot_sel1_pins: boot-sel1-pins {
		pins = "boot_sel1";
		function = "boot_sel";
	};

	d0_boot_sel2_pins: boot-sel2-pins {
		pins = "boot_sel2";
		function = "boot_sel";
	};

	d0_boot_sel3_pins: boot-sel3-pins {
		pins = "boot_sel3";
		function = "boot_sel";
	};

	d0_ddr_ref_clk_sel_pins: ddr-ref-clk-sel-pins {
		pins = "gpio95";
		function = "ddr_ref_clk_sel";
	};

	d0_lpddr_ref_clk_pins: lpddr-ref-clk-pins {
		pins = "lpddr_ref_clk";
		function = "lpddr_ref_clk";
	};

	d0_spi0_pins: spi0-pins {
		pins = "spi0_cs_n", "spi0_clk", "spi0_d0", "spi0_d1", "spi0_d2", "spi0_d3";
		function = "spi";
	};

	d0_dual_spi1_pins: dual-spi1-pins {
		pins = "spi1_cs0_n", "spi1_clk", "spi1_d0", "spi1_d1";
		function = "spi";
	};

	d0_quad_spi1_pins: quad-spi1-pins {
		pins = "spi1_cs0_n", "spi1_cs1_n", "spi1_clk", "spi1_d0", "spi1_d1", "spi1_d2", "spi1_d3";
		function = "spi";
	};

	d0_spi3_pins: spi3-pins {
		pins = "spi3_cs_n", "spi3_clk", "spi3_di", "spi3_do";
		function = "spi";
	};
};

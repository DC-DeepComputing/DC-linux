## Documentation/devicetree/bindings/display/bridge/innosilicon,inno-hdmi.yaml
```yaml
# SPDX-License-Identifier: (GPL-2.0-only OR BSD-2-Clause)
%YAML 1.2
---
$id: http://devicetree.org/schemas/display/bridge/innosilicon,inno-hdmi.yaml#
$schema: http://devicetree.org/meta-schemas/core.yaml#

title: Common Properties for Innosilicon HDMI TX IP

maintainers:
  - Keith Zhao <keith.zhao@starfivetech.com>

description: |
  This document defines device tree properties for the Innosilicon HDMI TX
  controller (INNO HDMI) IP core. It doesn't constitute a full device tree
  binding specification by itself but is meant to be referenced by device tree
  bindings for the platform-specific integrations of the INNO HDMI.

  When referenced from platform device tree bindings the properties defined in
  this document are defined as follows. The platform device tree bindings are
  responsible for defining whether each property is required or optional.

properties:
  reg:
    maxItems: 1

  interrupts:
    maxItems: 1

  ports:
    $ref: /schemas/graph.yaml#/properties/ports

    properties:
      port@0:
        $ref: /schemas/graph.yaml#/properties/port
        description:
          Port node with one endpoint connected to a display controller node.

      port@1:
        $ref: /schemas/graph.yaml#/properties/port
        description:
          Port node with one endpoint connected to a hdmi-connector node.

    required:
      - port@0
      - port@1

additionalProperties: true

...
```

## Documentation/devicetree/bindings/display/starfive/starfive,jh7110-dc8200.yaml
```yaml
# SPDX-License-Identifier: (GPL-2.0-only OR BSD-2-Clause)
%YAML 1.2
---
$id: http://devicetree.org/schemas/display/starfive/starfive,jh7110-dc8200.yaml#
$schema: http://devicetree.org/meta-schemas/core.yaml#

title: STARFIVE JH7110 SoC display controller

description:
  The STARFIVE JH7110 SoC uses the display controller based on Verisilicon IP(DC8200)
  to transfer the image data from a video memory buffer to an external LCD interface.

  pipe0 binds HDMI for primary display,
  pipe1 binds DSI for external display.

          +------------------------------+
          |                              |
          |                              |
  +----+  |   +-------------------+      |   +-------+   +------+   +------+
  |    +----->+  dc controller 0  +--->----->+HDMICtl| ->+ PHY  +-->+PANEL0+
  |AXI |  |   +-------------------+      |   +-------+   +------+   +------+
  |    |  |                              |
  |    |  |                              |
  |    |  |                              |
  |    |  |                              |
  |APB |  |   +-------------------+         +---------+    +------+  +-------+
  |    +----->+  dc controller 1  +--->---->+ dsiTx   +--->+DPHY  +->+ PANEL1+
  |    |  |   +-------------------+         +---------+    +------+  +-------+
  +----+  |                              |
          +------------------------------+

maintainers:
  - Keith Zhao <keith.zhao@starfivetech.com>

properties:
  compatible:
    const: starfive,jh7110-dc8200

  reg:
    items:
      - description: host interface address and length
      - description: display physical base address and length

  reg-names:
    items:
      - const: host
      - const: base

  clocks:
    items:
      - description: Clock for display system noc bus.
      - description: Core clock for display controller.
      - description: Clock for axi bus to access ddr.
      - description: Clock for ahb bus to R/W the phy regs.
      - description: Pixel clock for display channel 0.
      - description: Pixel clock for display channel 1.
      - description: Pixel clock from hdmi.
      - description: Pixel clock for soc .

  clock-names:
    items:
      - const: noc_bus
      - const: dc_core
      - const: axi_core
      - const: ahb
      - const: channel0
      - const: channel1
      - const: hdmi_tx
      - const: dc_parent

  resets:
    items:
      - description: Reset for axi bus.
      - description: Reset for ahb bus.
      - description: Core reset of display controller.

  reset-names:
    items:
      - const: axi
      - const: ahb
      - const: core

  interrupts:
    items:
      - description: The interrupt will be generated when DC finish one frame

  ports:
    $ref: /schemas/graph.yaml#/properties/ports

    properties:
      port@0:
        $ref: /schemas/graph.yaml#/properties/port
        description:
          channel 0 output

      port@1:
        $ref: /schemas/graph.yaml#/properties/port
        description:
          channel 1 output

    required:
      - port@0
      - port@1

required:
  - compatible
  - reg
  - interrupts
  - clocks
  - clock-names
  - ports

additionalProperties: false

examples:
  - |
    #include <dt-bindings/clock/starfive,jh7110-crg.h>
    #include <dt-bindings/reset/starfive,jh7110-crg.h>
    dc8200: lcd-controller@29400000 {
      compatible = "starfive,jh7110-dc8200";
        reg = <0x0 0x29400000 0x0 0x100>,
              <0x0 0x29400800 0x0 0x2000>;
        reg-names = "host", "base";

        interrupts = <95>;
        clocks = <&syscrg JH7110_SYSCLK_NOC_BUS_DISP_AXI>,
            <&voutcrg JH7110_VOUTCLK_DC8200_CORE>,
            <&voutcrg JH7110_VOUTCLK_DC8200_AXI>,
            <&voutcrg JH7110_VOUTCLK_DC8200_AHB>,
            <&voutcrg JH7110_VOUTCLK_DC8200_PIX0>,
            <&voutcrg JH7110_VOUTCLK_DC8200_PIX1>,
            <&hdmitx0_pixelclk>,
            <&voutcrg JH7110_VOUTCLK_DC8200_PIX>;
        clock-names = "noc_bus", "dc_core", "axi_core", "ahb",
                  "channel0", "channel1", "hdmi_tx", "dc_parent";
        resets = <&voutcrg JH7110_VOUTRST_DC8200_AXI>,
             <&voutcrg JH7110_VOUTRST_DC8200_AHB>,
             <&voutcrg JH7110_VOUTRST_DC8200_CORE>;
        reset-names = "axi","ahb", "core";

      crtc_out: ports {
        #address-cells = <1>;
        #size-cells = <0>;

        dc_out0: port@0 {
          reg = <0>;
          #address-cells = <1>;
          #size-cells = <0>;

          dc_out_dpi0: endpoint@0 {
              reg = <0>;
              remote-endpoint = <&hdmi_enc>;
          };

        };

        dc_out1: port@1 {
          reg = <1>;
          #address-cells = <1>;
          #size-cells = <0>;

          dc_out_dpi1: endpoint@1 {
              reg = <1>;
              remote-endpoint = <&dsi_enc>;
          };

        };
      };
    };
```

## Documentation/devicetree/bindings/display/starfive/starfive,jh7110-inno-hdmi.yaml
```yaml
# SPDX-License-Identifier: (GPL-2.0-only OR BSD-2-Clause)
%YAML 1.2
---
$id: http://devicetree.org/schemas/display/starfive/starfive,jh7110-inno-hdmi.yaml#
$schema: http://devicetree.org/meta-schemas/core.yaml#

title: Starfive JH7110 Innosilicon HDMI controller

maintainers:
  - Keith Zhao <keith.zhao@starfivetech.com>

allOf:
  - $ref: ../bridge/innosilicon,inno-hdmi.yaml#

properties:
  compatible:
    const: "starfive,jh7110-inno-hdmi"

  clocks:
    items:
      - description: System clock of HDMI module.
      - description: Mclk clock of HDMI audio.
      - description: Bclk clock of HDMI audio.

  clock-names:
    items:
      - const: sysclk
      - const: mclk
      - const: bclk

  resets:
    maxItems: 1

required:
  - compatible
  - reg
  - interrupts
  - clocks
  - clock-names
  - resets
  - ports

unevaluatedProperties: false

examples:
  - |
    #include <dt-bindings/pinctrl/starfive,jh7110-pinctrl.h>
    #include <dt-bindings/gpio/gpio.h>
    hdmi: hdmi@29590000 {
      compatible = "starfive,jh7110-inno-hdmi";
      reg = <0x29590000 0x4000>;
      interrupts = <99>;
      clocks = <&voutcrg 17>, <&voutcrg 15>, <&voutcrg 16>;
      clock-names = "sysclk", "mclk","bclk";
      resets = <&voutcrg 9>;

        ports {
          #address-cells = <1>;
          #size-cells = <0>;

          hdmi_in: port@0 {
            reg = <0>;
            hdmi_in_vop: endpoint {
              remote-endpoint = <&dc_out_dpi0>;
            };
          };

          hdmi_out: port@1 {
            reg = <1>;
            hdmi_out_con: endpoint {
              remote-endpoint = <&hdmi_con_in>;
            };
          };
        };
    };
```

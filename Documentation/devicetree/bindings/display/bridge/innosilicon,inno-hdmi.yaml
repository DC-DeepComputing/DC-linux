## drivers/gpu/drm/bridge/innosilicon/Kconfig
```kconfig
# SPDX-License-Identifier: GPL-2.0-only
config DRM_INNO_HDMI_STARFIVE
	tristate
	help
	  Support the common interface which is part of the INNO
	  Designware HDMI block.
```

## drivers/gpu/drm/verisilicon/Kconfig
```kconfig
# SPDX-License-Identifier: GPL-2.0
config DRM_VERISILICON_DC8200
	tristate "DRM Support for VeriSilicon DC8200"
	depends on DRM
	select DRM_KMS_HELPER
	select DRM_GEM_DMA_HELPER
	select CMA
	select DMA_CMA
	help
	  Choose this option if you have a VeriSilicon DC8200 chipset.
	  This driver provides VeriSilicon kernel mode
	  setting and buffer management. It does not
	  provide 2D or 3D acceleration.
```

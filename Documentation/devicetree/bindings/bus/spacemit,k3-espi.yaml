## Documentation/devicetree/bindings/bus/spacemit,k3-espi.yaml
```yaml
# SPDX-License-Identifier: (GPL-2.0-only OR BSD-2-Clause)
%YAML 1.2
---
$id: http://devicetree.org/schemas/bus/spacemit,k3-espi.yaml#
$schema: http://devicetree.org/meta-schemas/core.yaml#

title: SpacemiT K3 eSPI controller

maintainers:
  - Yixun Lan <dlan@kernel.org>

description: |
  The K3 eSPI controller connects the application processor to an embedded
  controller. Child registers are accessed through a peripheral shared-memory
  window, translated by ranges. The controller manages clocks, resets and
  channel negotiation, including link recovery after an EC reboot.

properties:
  compatible:
    const: spacemit,k3-espi

  reg:
    maxItems: 1

  '#address-cells':
    const: 1

  '#size-cells':
    const: 1

  ranges:
    maxItems: 1

  clocks:
    items:
      - description: Serial clock source
      - description: Serial clock
      - description: Bus clock

  clock-names:
    items:
      - const: sclk_src
      - const: sclk
      - const: mclk

  resets:
    items:
      - description: Bus reset
      - description: Serial clock reset

  pr-mem-base0:
    $ref: /schemas/types.yaml#/definitions/uint32
    description: First peripheral memory translation base.

  pr-mem-base1:
    $ref: /schemas/types.yaml#/definitions/uint32
    description: Second peripheral memory translation base.

  operating-frequency:
    $ref: /schemas/types.yaml#/definitions/uint32
    description: Requested link clock frequency in MHz.
    enum: [20, 25, 33, 50, 66]
    default: 20

  io-mode:
    $ref: /schemas/types.yaml#/definitions/string
    description: Requested number of eSPI data lines.
    enum: [single, dual, quad]
    default: single

  alert-mode:
    $ref: /schemas/types.yaml#/definitions/string
    description: Use the shared IO1 line or the dedicated alert pin.
    enum: [io1, pin]
    default: io1

  alert-type:
    $ref: /schemas/types.yaml#/definitions/string
    description: Electrical mode of the dedicated alert pin.
    enum: [open-drain, push-pull]
    default: open-drain

  watchdog-timeout:
    $ref: /schemas/types.yaml#/definitions/uint32
    description: Controller watchdog counter value.
    maximum: 65535
    default: 65535

  crc-enable:
    type: boolean
    description: Enable link CRC checking.

  auto-gating-enable:
    type: boolean
    description: Enable automatic controller clock gating.

  peripheral-channel-enable:
    type: boolean
    description: Enable the peripheral channel.

  vwire-channel-enable:
    type: boolean
    description: Enable the virtual-wire channel.

  oob-channel-enable:
    type: boolean
    description: Enable the out-of-band channel.

  flash-channel-enable:
    type: boolean
    description: Enable the flash access channel.

patternProperties:
  '^ec@[0-9a-f]+$':
    $ref: /schemas/embedded-controller/google,cros-ec.yaml#

required:
  - compatible
  - reg
  - '#address-cells'
  - '#size-cells'
  - ranges
  - clocks
  - clock-names
  - resets

additionalProperties: false
```

## drivers/gpu/drm/img/Kconfig
```kconfig
# SPDX-License-Identifier: GPL-2.0-only
config DRM_IMG
	bool "Imagination PowerVR GPU"
        default n

source "drivers/gpu/drm/img/img-volcanic/Kconfig"
```
